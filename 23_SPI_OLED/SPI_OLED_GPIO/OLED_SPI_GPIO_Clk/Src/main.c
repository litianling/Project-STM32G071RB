/**************************
		识别图像
		①下载图片
		②打开PS将图片像素改为128*64
		③数据水平，字节垂直
		④字节内像素数据反序
		生成矩阵
		改成二维矩阵（便于理解）
**************************/

/*******************************
		PA4→D0	SPI时钟线
		PA3→D1	SPI数据线
		PA2→RES	复位信号
		PA1→DC	SPI数据/命令选择
		PA0→CS	片选信号
*******************************/
//输出数字时，调用数字转字符串函数更简洁！！！

#include "main.h"
#define SET 1
#define RESET 0
#define OLED_CMD 0
#define OLED_DATA 1

#define SIZE 				16		//字符与数字 字体大小16为大其他为小
#define X_WIDTH 		128
#define Y_WIDTH 		64

int mode=1;
int	second=0;
int minute=0;
int hour=0;


/*******************
		常用ASCII表
		偏移量32
		单个字符大小6列1（*8）行像素
		小字体模式 只在下半屏幕输出
*******************/
const unsigned char L6H8[][6] =
{
	{0x00, 0x00, 0x00, 0x00, 0x00, 0x00},// space 空格
	{0x00, 0x00, 0x00, 0x2f, 0x00, 0x00},// !
	{0x00, 0x00, 0x07, 0x00, 0x07, 0x00},// "
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	{0x14, 0x14, 0x14, 0x14, 0x14, 0x14},// horiz lines
};


/*******************
		常用ASCII表
		偏移量32
		单个字符大小8列2（*8）行像素
		大字体模式
*******************/
const unsigned char L8H16[][8]=
{
  {0x00,0x00,0x00,0x00,0x00,0x00,0x00,0x00},
	{0x00,0x00,0x00,0x00,0x00,0x00,0x00,0x00},//space 0
  {0x00,0x00,0x00,0xF8,0x00,0x00,0x00,0x00},
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	{0x00,0x00,0x00,0x00,0x00,0x00,0x00,0x00},//~ 94
};


/*****************************
		图像显示，横排扫描
		8（*8）行128列
		无划分
*****************************/
unsigned char BMP1[][128] =
{
	{0x00,0x03,0x05,0x09,0x11,0xFF,0x11,0x89,0x05,0xC3,0x00,0xE0,0x00,0xF0,0x00,0xF8,
	0x00,0x00,0x00,0x00,0x00,0x00,0x00,0x44,0x28,0xFF,0x11,0xAA,0x44,0x00,0x00,0x00,
	0x00,0x00,0x00,0x00,0x00,0x00,0x00,0x00,0x00,0x00,0x00,0x00,0x00,0x00,0x00,0x00,
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	0x00,0x00,0x26,0x49,0x49,0x49,0x32,0x00,0x00,0x7F,0x02,0x04,0x08,0x10,0x7F,0x00}
};


//驱动
void OLED_Set_Pos(unsigned char x, unsigned char y);
void OLED_WR_Byte(unsigned char dat,unsigned char cmd);
void OLED_Init(void);
void OLED_Clear(void);
void OLED_All(void);
void OLED_Display_On(void);
void OLED_Display_Off(void);
//字符以及字符串显示
void OLED_ShowChar(unsigned char x,unsigned char y,unsigned char chr);
void OLED_ShowString(unsigned char  x,unsigned char  y, unsigned char  *p);
//图片模式显示
void OLED_DrawBMP(unsigned char x0, unsigned char y0,unsigned char x1, unsigned char y1,unsigned char select_BMP);
//数字模式显示
int OLED_pow(unsigned char m,unsigned char n);
void OLED_ShowNum(unsigned char x,unsigned char y,unsigned int num,unsigned char len,unsigned char size2);


/* Private function prototypes -----------------------------------------------*/
void SystemClock_Config(void);
static void MX_GPIO_Init(void);


int main(void)
{
  HAL_Init();
	SystemClock_Config();
  MX_GPIO_Init();
  
	unsigned char t;
	OLED_Init();
	OLED_Clear();
  while (1)
  {
		while(mode==1)		//时钟模式
		{
			OLED_Clear();
			OLED_ShowString(20,2,"2021/06/01");
			while(mode==1)
			{
				if(hour==23&&minute==59&&second==59)
				{	hour=0;minute=0;second=0;}
				else if(minute==59&&second==59)
				{	hour++;minute=0;second=0;}
				else if(second==59)
				{	minute++;second=0;}
				else
					second++;
				OLED_ShowNum(28,4,hour,2,16);
				OLED_ShowChar(44,4,':');
				OLED_ShowNum(52,4,minute,2,16);
				OLED_ShowChar(68,4,':');
				OLED_ShowNum(76,4,second,2,16);
				HAL_Delay(1000);
			}
		}

		while(mode==2)	//图像显示模式
		{
			OLED_DrawBMP(0,0,128,8,1);  //图片显示(图片显示慎用，生成的字表较大，会占用较多空间，FLASH空间8K以下慎用)
			HAL_Delay(3000);
		}
  }
}

void SystemClock_Config(void)
{
  RCC_OscInitTypeDef RCC_OscInitStruct = {0};
  RCC_ClkInitTypeDef RCC_ClkInitStruct = {0};
  HAL_PWREx_ControlVoltageScaling(PWR_REGULATOR_VOLTAGE_SCALE1);
  RCC_OscInitStruct.OscillatorType = RCC_OSCILLATORTYPE_HSI;
  RCC_OscInitStruct.HSIState = RCC_HSI_ON;
  RCC_OscInitStruct.HSIDiv = RCC_HSI_DIV1;
  RCC_OscInitStruct.HSICalibrationValue = RCC_HSICALIBRATION_DEFAULT;
  RCC_OscInitStruct.PLL.PLLState = RCC_PLL_NONE;
  if (HAL_RCC_OscConfig(&RCC_OscInitStruct) != HAL_OK)
  {
    Error_Handler();
  }
  RCC_ClkInitStruct.ClockType = RCC_CLOCKTYPE_HCLK|RCC_CLOCKTYPE_SYSCLK
                              |RCC_CLOCKTYPE_PCLK1;
  RCC_ClkInitStruct.SYSCLKSource = RCC_SYSCLKSOURCE_HSI;
  RCC_ClkInitStruct.AHBCLKDivider = RCC_SYSCLK_DIV1;
  RCC_ClkInitStruct.APB1CLKDivider = RCC_HCLK_DIV1;

  if (HAL_RCC_ClockConfig(&RCC_ClkInitStruct, FLASH_LATENCY_0) != HAL_OK)
  {
    Error_Handler();
  }
}

static void MX_GPIO_Init(void)
{
  GPIO_InitTypeDef GPIO_InitStruct = {0};
  __HAL_RCC_GPIOC_CLK_ENABLE();
  __HAL_RCC_GPIOA_CLK_ENABLE();
  HAL_GPIO_WritePin(GPIOA, GPIO_PIN_0|GPIO_PIN_1|GPIO_PIN_2|GPIO_PIN_3
                          |GPIO_PIN_4|GPIO_PIN_5|GPIO_PIN_6|GPIO_PIN_7, GPIO_PIN_RESET);
  GPIO_InitStruct.Pin = GPIO_PIN_13;
  GPIO_InitStruct.Mode = GPIO_MODE_IT_RISING;
  GPIO_InitStruct.Pull = GPIO_NOPULL;
  HAL_GPIO_Init(GPIOC, &GPIO_InitStruct);

  GPIO_InitStruct.Pin = GPIO_PIN_0|GPIO_PIN_1|GPIO_PIN_2|GPIO_PIN_3
                          |GPIO_PIN_4|GPIO_PIN_5|GPIO_PIN_6|GPIO_PIN_7;
  GPIO_InitStruct.Mode = GPIO_MODE_OUTPUT_PP;
  GPIO_InitStruct.Pull = GPIO_NOPULL;
  GPIO_InitStruct.Speed = GPIO_SPEED_FREQ_LOW;
  HAL_GPIO_Init(GPIOA, &GPIO_InitStruct);
  HAL_NVIC_SetPriority(EXTI4_15_IRQn, 0, 0);
  HAL_NVIC_EnableIRQ(EXTI4_15_IRQn);
}

/* USER CODE BEGIN 4 */

/*******************************
		设置光标位置
		x为列数0-127共128列（128*1=128）
		y为行数0-7共8行（8*8=64）
*******************************/
void OLED_Set_Pos(unsigned char x, unsigned char y) 
{ 
	OLED_WR_Byte(0xb0+y,OLED_CMD);
	OLED_WR_Byte(((x&0xf0)>>4)|0x10,OLED_CMD);
	OLED_WR_Byte((x&0x0f)|0x01,OLED_CMD); 
}


/*******************************
		向SSD1306写入一个字节。
		dat:要写入的数据/命令
		cmd:数据/命令选择 0,表示命令;1,表示数据;
*******************************/
void OLED_WR_Byte(unsigned char dat,unsigned char select)
{	
	unsigned char i;			  
	if(select)
		HAL_GPIO_WritePin(GPIOA,GPIO_PIN_1,SET);		//数据/命令选择线DC=1输入数据
	else 
		HAL_GPIO_WritePin(GPIOA,GPIO_PIN_1,RESET);	//数据/命令选择线DC=0输入命令
	HAL_GPIO_WritePin(GPIOA,GPIO_PIN_0,RESET);		//片选CS=0低电平有效
	for(i=0;i<8;i++)	//一位一位地检测输出
	{
		HAL_GPIO_WritePin(GPIOA,GPIO_PIN_4,RESET);	//SPI时钟线D0=0
		if(dat&0x80)
			HAL_GPIO_WritePin(GPIOA,GPIO_PIN_3,SET);	//SPI数据线D1=1
		else
			HAL_GPIO_WritePin(GPIOA,GPIO_PIN_3,RESET);//SPI数据线D1=0
		HAL_GPIO_WritePin(GPIOA,GPIO_PIN_4,SET);		//SPI时钟线D0=1
		dat<<=1;
	}
	HAL_GPIO_WritePin(GPIOA,GPIO_PIN_0,SET);			//片选CS=1高电平失效
	HAL_GPIO_WritePin(GPIOA,GPIO_PIN_1,SET);			//数据/命令选择线DC=1等待输入数据
}


/*******************************
		初始化SSD1306
*******************************/
void OLED_Init(void)
{
	HAL_GPIO_WritePin(GPIOA,GPIO_PIN_2,SET);		// 复位信号RES=1	
	HAL_Delay(100);
	HAL_GPIO_WritePin(GPIOA,GPIO_PIN_2,RESET);	// 复位信号RES=0
	HAL_Delay(100);
	HAL_GPIO_WritePin(GPIOA,GPIO_PIN_2,SET);		// 复位信号RES=1

	OLED_WR_Byte(0xAE,OLED_CMD);//--turn off oled panel
	OLED_WR_Byte(0x00,OLED_CMD);//---set low column address
	OLED_WR_Byte(0x10,OLED_CMD);//---set high column address
	OLED_WR_Byte(0x40,OLED_CMD);//--set start line address  Set Mapping RAM Display Start Line (0x00~0x3F)
	OLED_WR_Byte(0x81,OLED_CMD);//--set contrast control register
	OLED_WR_Byte(0xCF,OLED_CMD); // Set SEG Output Current Brightness
	OLED_WR_Byte(0xA1,OLED_CMD);//--Set SEG/Column Mapping     0xa0左右反置 0xa1正常
	OLED_WR_Byte(0xC8,OLED_CMD);//Set COM/Row Scan Direction   0xc0上下反置 0xc8正常
	OLED_WR_Byte(0xA6,OLED_CMD);//--set normal display
	OLED_WR_Byte(0xA8,OLED_CMD);//--set multiplex ratio(1 to 64)
	OLED_WR_Byte(0x3f,OLED_CMD);//--1/64 duty
	OLED_WR_Byte(0xD3,OLED_CMD);//-set display offset	Shift Mapping RAM Counter (0x00~0x3F)
	OLED_WR_Byte(0x00,OLED_CMD);//-not offset
	OLED_WR_Byte(0xd5,OLED_CMD);//--set display clock divide ratio/oscillator frequency
	OLED_WR_Byte(0x80,OLED_CMD);//--set divide ratio, Set Clock as 100 Frames/Sec
	OLED_WR_Byte(0xD9,OLED_CMD);//--set pre-charge period
	OLED_WR_Byte(0xF1,OLED_CMD);//Set Pre-Charge as 15 Clocks & Discharge as 1 Clock
	OLED_WR_Byte(0xDA,OLED_CMD);//--set com pins hardware configuration
	OLED_WR_Byte(0x12,OLED_CMD);
	OLED_WR_Byte(0xDB,OLED_CMD);//--set vcomh
	OLED_WR_Byte(0x40,OLED_CMD);//Set VCOM Deselect Level
	OLED_WR_Byte(0x20,OLED_CMD);//-Set Page Addressing Mode (0x00/0x01/0x02)
	OLED_WR_Byte(0x02,OLED_CMD);//
	OLED_WR_Byte(0x8D,OLED_CMD);//--set Charge Pump enable/disable
	OLED_WR_Byte(0x14,OLED_CMD);//--set(0x10) disable
	OLED_WR_Byte(0xA4,OLED_CMD);// Disable Entire Display On (0xa4/0xa5)
	OLED_WR_Byte(0xA6,OLED_CMD);// Disable Inverse Display On (0xa6/a7) 
	OLED_WR_Byte(0xAF,OLED_CMD);//--turn on oled panel
	
	OLED_WR_Byte(0xAF,OLED_CMD); /*display ON*/ 
	OLED_Clear();
	OLED_Set_Pos(0,0); 	
} 


/*******************************
		清屏函数。
		因为OLED自发光，无背光。
		所以清完屏,整个屏幕是黑色的!
		和没点亮一样!!!
*******************************/
void OLED_Clear(void)  
{
	for(unsigned char y=0;y<8;y++)	//8行*8位数据（64）
	{
		OLED_Set_Pos(0,y);	//只有行地址不同时需要设置起始位
		for(unsigned char x=0;x<128;x++)
			OLED_WR_Byte(0x00,OLED_DATA);		//列地址是自动加的
	}
}


/*******************************
		蓝屏函数
		全部点亮
*******************************/
void OLED_All(void)  
{
	for(unsigned char y=0;y<8;y++)
	{
		OLED_Set_Pos(0,y);
		for(unsigned char x=0;x<128;x++)
			OLED_WR_Byte(0xff,OLED_DATA);
	}
}


/*开启OLED显示*/   
void OLED_Display_On(void)
{
	OLED_WR_Byte(0X8D,OLED_CMD);  //SET DCDC命令
	OLED_WR_Byte(0X14,OLED_CMD);  //DCDC ON
	OLED_WR_Byte(0XAF,OLED_CMD);  //DISPLAY ON
}
/*关闭OLED显示*/    
void OLED_Display_Off(void)
{
	OLED_WR_Byte(0X8D,OLED_CMD);  //SET DCDC命令
	OLED_WR_Byte(0X10,OLED_CMD);  //DCDC OFF
	OLED_WR_Byte(0XAE,OLED_CMD);  //DISPLAY OFF
}
//*********************************************************************************************************


/*******************************
		在指定位置显示一个字符,包括部分字符
		x:0~127列		y:0~7行（8行*8位）
		mode:0,反白显示;1,正常显示				 
		size:选择字体 16/12 
*******************************/
void OLED_ShowChar(unsigned char x,unsigned char y,unsigned char chr)
{
	unsigned char nomber=0,i=0;	
	nomber=chr-' ';//得到偏移后的值即ASC码偏移量  设置空格为0号字符
	if(x>X_WIDTH-1)	//如果超出这一行自动跳转到下一行（+2）
	{
		x=0;
		y=y+2;
	}
	if(SIZE ==16) //按照16号字体显示	显示方式与原理同汉字
	{
		OLED_Set_Pos(x,y);	
		for(i=0;i<8;i++)
			OLED_WR_Byte(L8H16[nomber*2][i],OLED_DATA);
		OLED_Set_Pos(x,y+1);
		for(i=0;i<8;i++)
			OLED_WR_Byte(L8H16[nomber*2+1][i],OLED_DATA);
	}
	else //字体除了16以外都是小字体，设置其他值无用
	{
		OLED_Set_Pos(x,y+1);	//设置起始地址为下半屏幕
		for(i=0;i<6;i++)
			OLED_WR_Byte(L6H8[nomber][i],OLED_DATA);
	}
}


/*******************************
		显示一个字符串
*******************************/
void OLED_ShowString(unsigned char x,unsigned char y,unsigned char *chr)
{
	unsigned char i=0;
	while (chr[i]!='\0')	//不是字符串的结束则一直循环
	{	
		OLED_ShowChar(x,y,chr[i]);	//在x，y处显示字符
		x+=8;												//x=x+8 列地址加8准备显示下一字符
		if(x>120)										//位置不够显示当前字符，去下一行显示
		{
			x=0;
			y+=2;
		}
		i++;	//扫描下一字符
	}
}

//*********************************************************************************************************

/*******************************
		显示显示BMP图片128×64
		起始点坐标(x,y)
		列x的范围0-127，行y的范围0-7
		x0y0起始，x1y1结束
*******************************/
void OLED_DrawBMP(unsigned char x0,unsigned char y0,unsigned char x1,unsigned char y1,unsigned char select_BMP)
{ 
	for(unsigned char y=y0;y<y1;y++)
	{
		OLED_Set_Pos(x0,y);
    for(unsigned char x=x0;x<x1;x++)
				OLED_WR_Byte(BMP1[y][x],OLED_DATA);
	}
} 

//*********************************************************************************************************



/*******************************
		幂函数m^n
		用来辅助获取要显示的某一位
*******************************/
int OLED_pow(unsigned char m,unsigned char n)
{
	unsigned int result=1;	 
	while(n--) result*=m;    
	return result;
}


/*******************************
		显示2个数字
		x,y :起点坐标
		len :数字的位数
		size:字体大小
		num:数值(0~4294967295);	
*******************************/
void OLED_ShowNum(unsigned char x,unsigned char y,unsigned int num,unsigned char len,unsigned char size2)
{         	
	unsigned char t,number_byte;	//循环与输出位
	unsigned char enshow=0;	//显示控制变量，显示完置一			   
	for(t=0;t<len;t++)
	{
		number_byte=(num/OLED_pow(10,len-t-1))%10;		//输出位，从高到低检测

		if(number_byte!=0)		//显示内容非0，开启显示（之后不再显示空格）
		{
			enshow=1;
			OLED_ShowChar(x+(size2/2)*t,y,number_byte+'0');
		}
//		else if(enshow==0)	//显示内容为0，且没有开启显示，显示空格
//			OLED_ShowChar(x+(size2/2)*t,y,' ');
		else								//开启显示之后，正常显示0
			OLED_ShowChar(x+(size2/2)*t,y,'0');
	}
}
/* USER CODE END 4 */


void HAL_GPIO_EXTI_Rising_Callback(uint16_t GPIO_Pin)
{
	if(GPIO_Pin==0x2000)
	{
		if(mode==2)
			mode=1;
		else
			mode++;
	}
}

/* USER CODE END 4 */

void Error_Handler(void)
{
  __disable_irq();
  while (1)
  {
  }
}

#ifdef  USE_FULL_ASSERT
/**
  * @brief  Reports the name of the source file and the source line number
  *         where the assert_param error has occurred.
  * @param  file: pointer to the source file name
  * @param  line: assert_param error line source number
  * @retval None
  */
void assert_failed(uint8_t *file, uint32_t line)
{
  /* USER CODE BEGIN 6 */
  /* User can add his own implementation to report the file name and line number,
     ex: printf("Wrong parameters value: file %s on line %d\r\n", file, line) */
  /* USER CODE END 6 */
}
#endif /* USE_FULL_ASSERT */

/************************ (C) COPYRIGHT STMicroelectronics *****END OF FILE****/
